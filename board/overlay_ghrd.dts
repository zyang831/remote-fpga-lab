/dts-v1/;
/plugin/;

/* Idle GHRD overlay: program the bitstream, expose nothing. */
&{/fpga-region} {
	#address-cells = <2>;
	#size-cells = <2>;
	ranges = <0 0 0 0x20000000 0 0x40000>;
	firmware-name = "output_design.core.rbf";
	config-complete-timeout-us = <30000000>;
};
