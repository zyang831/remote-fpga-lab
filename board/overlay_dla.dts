/dts-v1/;
/plugin/;

/*
 * CoreDLA design overlay. Applied by coredla-fpga-up.sh via configfs; the
 * fpga-region driver programs /lib/firmware/output_design.core.rbf first and
 * only then creates the child devices, so altera-msgdma / msgdma_userio can
 * never probe against an unconfigured or foreign fabric.
 *
 * Child addresses are LWH2F offsets (bridge base 0x20000000 via `ranges`).
 * Node names are load-bearing: msgdma_userio names /dev/msgdma_coredla0 from
 * its node, uio_pdrv_genirq names the UIO device "coredla0"; the MMD looks
 * both up by name. See ../source/socfpga_agilex5.dtsi.patch for the map.
 */
&{/fpga-region} {
	#address-cells = <2>;
	#size-cells = <2>;
	ranges = <0 0 0 0x20000000 0 0x40000>;
	firmware-name = "output_design.core.rbf";
	config-complete-timeout-us = <30000000>;

	coredla_msgdma: msgdma@21000 {
		compatible = "altr,socfpga-msgdma";
		reg = <0 0x21000 0 0x20>, <0 0x21020 0 0x20>;
		reg-names = "csr", "desc";
		interrupt-parent = <&intc>;
		interrupts = <0 20 4>;
		#dma-cells = <1>;
	};

	msgdma_coredla0 {
		compatible = "intel,msgdma-userio-1.0";
		#address-cells = <2>;
		mem_start = <0 0xb0000000>;
		mem_end   = <0 0xbfffffff>;
		reg-names = "emif";
		dmas = <&coredla_msgdma 0>;
		dma-names = "rx-tx";
	};

	coredla0@20000 {
		compatible = "generic-uio";
		reg = <0 0x20000 0 0x800>;
	};
};
